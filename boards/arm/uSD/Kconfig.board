## boards/arm/uSD/Kconfig.board
```kconfig
# Copyright (c) 2023 Nordic Semiconductor ASA
# SPDX-License-Identifier: Apache-2.0

config BOARD_USD
	bool "uSD"
	depends on SOC_NRF52832_CIAA
```

## boards/arm/uSD/Kconfig.defconfig
```kconfig
# Copyright (c) 2023 Nordic Semiconductor ASA
# SPDX-License-Identifier: Apache-2.0

if BOARD_USD

config BOARD
	default "uSD"

config BT_CTLR
   default BT

endif
```
